## embedded-evnt-controller/deployment/yocto/meta-vehicle/conf/layer.conf
```bitbake
BBPATH .= ":${LAYERDIR}"

BBFILES += "${LAYERDIR}/recipes-*/*/*.bb \
            ${LAYERDIR}/recipes-*/*/*.bbappend"

BBFILE_COLLECTIONS += "vehicle"
BBFILE_PATTERN_vehicle = "^${LAYERDIR}/"
BBFILE_PRIORITY_vehicle = "6"

LAYERSERIES_COMPAT_vehicle = "scarthgap styhead walnascar"
```
